## meta-mion-accton/conf/machine/accton-as4610-30.conf
```bitbake
#@TYPE: Machine
#@NAME: accton-as4610-30 

#@DESCRIPTION: Machine configuration for accton-as4610-30 systems

require conf/platform-profiles/platform-accton.inc

PREFERRED_PROVIDER_virtual/kernel ?= "linux-yocto"
PREFERRED_VERSION_linux-yocto ?= "5.4%"

require conf/machine/include/tune-cortexa9.inc

MACHINE_FEATURES_remove += "alsa"

ONIE_VENDOR="accton"

KERNEL_CLASSES += "kernel-fitimage"
KERNEL_IMAGETYPE = "fitImage"
KERNEL_DEVICETREE = "arm-accton-as4610.dtb"

INITRAMFS_MAXSIZE = "180000"
INITRAMFS_IMAGE = "mion-onie-image-onlpv1-initramfs"
INITRAMFS_IMAGE_BUNDLE = "1"

FIT_HASH_ALG = "sha1"

MACHINE_EXTRA_RRECOMMENDS = "kernel-modules kernel-devicetree"

IMAGE_INSTALL_append = " kernel-devicetree "

UBOOT_ENTRYPOINT = "0x61008000"
UBOOT_LOADADDRESS = "0x61008000"

UBOOT_RD_ENTRYPOINT = "0x00000000"
UBOOT_RD_LOADADDRESS = "0x00000000"

KERNEL_EXTRA_ARGS = "LOADADDR=0x61008000"

ONL_ARCH = "armhf"
ONIE_ARCH = "armhf"

MACHINEOVERRIDES =. "as4610-30:"
```

## meta-mion-delta/conf/machine/tn48m.conf
```bitbake
#@TYPE: Machine
#@NAME: tm48m 
#@DESCRIPTION: Machine configuration for delta tm48m systems

require conf/platform-profiles/platform-delta.inc
require conf/machine/include/tune-cortexa72.inc

TARGET_ARCH="aarch64"

KERNEL_CLASSES += "kernel-fitimage"
KERNEL_IMAGETYPE = "fitImage"
KERNEL_DEVICETREE = "marvell/delta-tn48m.dtb"

INITRAMFS_MAXSIZE = "180000"
INITRAMFS_IMAGE = "mion-onie-image-onlpv1-initramfs"
INITRAMFS_IMAGE_BUNDLE = "1"

UBOOT_ENTRYPOINT = "0x400000"
UBOOT_LOADADDRESS = "0x400000"

UBOOT_MACHINE = "mvebu_armada-8k"

MACHINE_EXTRA_RRECOMMENDS = "kernel-modules"

#EXTRA_IMAGEDEPENDS += "u-boot"

IMAGE_INSTALL_append = " kernel-devicetree kernel-image-zimage"

KERNEL_EXTRA_ARGS += "LOADADDR=${UBOOT_ENTRYPOINT}"

SERIAL_CONSOLES ?= "115200;ttyAMA0 115200;hvc0"
SERIAL_CONSOLES_CHECK = "${SERIAL_CONSOLES}"

PREFERRED_PROVIDER_virtual/kernel ?= "linux-yocto"
PREFERRED_VERSION_linux-yocto ?= "5.4%"

MACHINE_FEATURES += "pcbios efi tpm2"
MACHINE_FEATURES_remove += "alsa"

GLIBC_ADDONS = "nptl"

ONIE_VENDOR="delta"

# Baseboard config, we don't load them as baseboard conf does the insmod
MACHINE_ESSENTIAL_EXTRA_RDEPENDS+=" optoe"
MACHINE_ESSENTIAL_EXTRA_RDEPENDS+=" arm64-delta-tn48m-cpld"
MACHINE_ESSENTIAL_EXTRA_RDEPENDS+=" arm64-delta-tn48m-led"
MACHINEOVERRIDES =. "delta-tn48m"
```

## meta-mion-ufispace/conf/layer.conf
```bitbake
# We have a conf and classes directory, add to BBPATH
BBPATH .= ":${LAYERDIR}"

# We have recipes-* directories, add to BBFILES
BBFILES += "${LAYERDIR}/recipes-*/*/*.bb \
            ${LAYERDIR}/recipes-*/*/*.bbappend"

BBFILE_COLLECTIONS += "meta-mion-ufispace"
BBFILE_PATTERN_meta-mion-ufispace = "^${LAYERDIR}/"
BBFILE_PRIORITY_meta-mion-ufispace = "6"

LAYERDEPENDS_meta-mion-ufispace = "core"
LAYERSERIES_COMPAT_meta-mion-ufispace = "dunfell"
```

## meta-mion-ufispace/conf/machine/ufispace-s9700-53dx.conf
```bitbake
#@TYPE: Machine
#@NAME: ufispace-s9700-53dx 

#@DESCRIPTION: Machine configuration for ufispace-s9700-53dx systems

require conf/platform-profiles/platform-ufispace.inc

PREFERRED_PROVIDER_virtual/kernel ?= "linux-yocto"
PREFERRED_VERSION_linux-yocto ?= "5.4%"

DEFAULTTUNE ?= "corei7-64"

require conf/machine/include/tune-corei7.inc
require conf/machine/include/x86-base.inc

MACHINE_FEATURES += "pcbios efi tpm2"
MACHINE_FEATURES_remove += "alsa"

SYSLINUX_OPTS = "serial 0 115200n8"
SERIAL_CONSOLE = "115200 ttyS0"
APPEND += "console=ttyS0,115200n8"

CONSOLE_SPEED = "115200"
CONSOLE_DEV = "0"
CONSOLE_PORT = "0x3f8"

GLIBC_ADDONS = "nptl"

MACHINE_ESSENTIAL_EXTRA_RDEPENDS += "platform-ufispace-s9700-53dx"

ONIE_VENDOR = "ufispace"

# Baseboard config, we don't load them as baseboard conf does the insmod
MACHINE_ESSENTIAL_EXTRA_RDEPENDS +="x86-64-ufispace-eeprom-mb"
MACHINE_ESSENTIAL_EXTRA_RDEPENDS +="x86-64-ufispace-s9700-53dx-cpld"
MACHINE_ESSENTIAL_EXTRA_RDEPENDS +="x86-64-ufispace-s9700-53dx-lpc"
MACHINE_ESSENTIAL_EXTRA_RDEPENDS +="x86-64-ufispace-s9700-53dx-onie-syseeprom"
MACHINE_ESSENTIAL_EXTRA_RDEPENDS += "optoe"

MACHINEOVERRIDES =. "s9700-53dx:"
```
